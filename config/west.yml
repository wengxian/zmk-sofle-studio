## config/west.yml
```yaml
manifest:
  remotes:
    - name: zmkfirmware
      url-base: https://github.com/urob
    - name: gpeye
      url-base: https://github.com/GPeye
    - name: urob
      url-base: https://github.com/urob
  projects:
    - name: zmk
      remote: zmkfirmware
      revision: main
      import: app/west.yml
    - name: urchin-peripheral-animation
      remote: gpeye
      revision: main 
    - name: zmk-helpers
      remote: urob
      revision: main
  self:
    path: config
```
